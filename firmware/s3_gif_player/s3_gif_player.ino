// ============================================================
// S3 GIF player — RLE-compressed RGB565 frames, full 240x291 res,
// all 33 source frames.
// ============================================================
//
// Fourth revision. History, from real profiling, not guesses:
//   1. Palette-indexed frames + on-device palette lookup + PSRAM
//      decode buffer: badly slow (PSRAM is bad at the scattered
//      per-pixel writes the lookup does).
//   2. Same, but decode buffer moved to internal SRAM: still ~half
//      the source GIF's frame rate.
//   3. WiFi-streamed raw RGB565 (server pre-decodes, device just
//      reads socket + pushes): even worse. Measured via a UDP debug
//      channel (serial never worked reliably on this board this
//      session): avg_push_ms ~40, avg_read_ms ~230-260. WiFiClient's
//      socket read, not the SPI push, was the real bottleneck.
//   4. Considered dirty-rectangle diffing (only push changed rows)
//      before building it -- checked the actual frame data first:
//      93.5% of rows change every single frame even with dithering
//      off (this is a full-body bounce/dance loop, not a mostly-
//      static idle animation). Diffing would save ~7%. Not worth it.
//   5. Raw RGB565, no palette, 176x213 (shrunk from source), 80MHz
//      SPI: this got real-time. Confirmed on the bench.
//   6. Scaled resolution up to the panel's full 240x291 by dropping
//      to every other source frame (17 of 33) to fit flash: worked,
//      still full speed, but half the temporal resolution.
//   7. This version: considered treating "always-white" pixel
//      positions as static background to skip redrawing -- checked
//      first before building it. Only 16.7% of positions are white
//      in literally every one of the 33 frames (character's bbox is
//      the full canvas, no dead margin -- it bounces edge to edge).
//      Not worth it either.
//   8. What actually worked: per-frame (not cross-frame) run-length
//      encoding. ~46% of any single frame's pixels are white-ish,
//      and large flat-color regions besides, so consecutive-pixel
//      runs compress well even though WHICH pixels are white moves
//      every frame. Measured 1.90x on the real data -- enough to fit
//      all 33 frames at the full 240x291 res in the 3MB budget
//      (2.32MB). No risk of erasing character detail: this only
//      changes how a frame is stored, not what gets drawn -- every
//      frame is still fully reconstructed and pushed whole.
//
// Format: per frame, two parallel PROGMEM arrays -- run lengths
// (uint8, capped at 255, longer runs split into multiple entries)
// and run pixel values (uint16 RGB565). Decode walks both in lockstep,
// replicating each run's pixel value into frameBuf. Generated by
// convert_rle565.py (session scratchpad).
//
// SPI clock at 80MHz (bumped from the original 40MHz in step 5).
//
// No WiFi in this build -- the WiFi/lwIP stack's own flash footprint
// doesn't fit alongside this much frame data in the 3MB huge_app
// partition (confirmed in step 5/6's builds). Serial.printf still
// goes out in case USB serial decides to cooperate.
//
// Board config (arduino-cli):
//   --fqbn esp32:esp32:esp32s3:PartitionScheme=huge_app

#include <Adafruit_GFX.h>
#include <Adafruit_ST7789.h>
#include <SPI.h>
#include <stdarg.h>
#include "gif_frames_rle.h"

// Pins: rev 3 carrier board (pcb/main.ato), display 1 socket (J3). SCK/MOSI/
// DC are shared by all three display sockets; each has its own CS/RST/BL.
// (Old bench rig -- SuperMini, panel wired to GPIO3-7: CS 3, DC 4, RST 5,
// MOSI 6, SCK 7.)
#define TFT_CS   8    // CS1
#define TFT_DC   9    // shared DC
#define TFT_RST  10   // RST1
#define TFT_MOSI 11   // shared, via 33R (FSPI IO_MUX pin, 80 MHz-capable)
#define TFT_SCK  12   // shared, via 33R (FSPI IO_MUX pin)
#define TFT_BL   3    // BL1 -> panel's backlight transistor (HIGH = on)
// displays 2/3 sit on the same bus: keep them deselected and dark
#define TFT2_CS  18
#define TFT3_CS  17
#define TFT2_BL  6
#define TFT3_BL  5

#define TFT_W 240
#define TFT_H 320

#define SPI_HZ 80000000

SPIClass tftSPI(FSPI);
Adafruit_ST7789 tft(&tftSPI, TFT_CS, TFT_DC, TFT_RST);

static uint16_t frameBuf[GIF_FRAME_W * GIF_FRAME_H];

void logf(const char *fmt, ...) {
  char buf[160];
  va_list args;
  va_start(args, fmt);
  vsnprintf(buf, sizeof(buf), fmt, args);
  va_end(args);
  Serial.println(buf);
}

void decodeFrame(uint8_t frameIdx) {
  const uint8_t *runLens = (const uint8_t *)pgm_read_ptr(&gifRunLens[frameIdx]);
  const uint16_t *runPixs = (const uint16_t *)pgm_read_ptr(&gifRunPixs[frameIdx]);
  uint32_t entries = gifFrameEntryCount[frameIdx];

  uint32_t out = 0;
  for (uint32_t i = 0; i < entries; i++) {
    uint8_t len = pgm_read_byte(&runLens[i]);
    uint16_t val = pgm_read_word(&runPixs[i]);
    for (uint8_t k = 0; k < len; k++) {
      frameBuf[out++] = val;
    }
  }
}

// Call first in setup(), before the display library touches the bus.
static void boardPinsInit() {
  pinMode(TFT2_CS, OUTPUT); digitalWrite(TFT2_CS, HIGH);
  pinMode(TFT3_CS, OUTPUT); digitalWrite(TFT3_CS, HIGH);
  pinMode(TFT2_BL, OUTPUT); digitalWrite(TFT2_BL, LOW);
  pinMode(TFT3_BL, OUTPUT); digitalWrite(TFT3_BL, LOW);
  pinMode(TFT_BL, OUTPUT);  digitalWrite(TFT_BL, HIGH);
}

void setup() {
  boardPinsInit();
  Serial.begin(115200);
  delay(200);

  tftSPI.begin(TFT_SCK, -1 /* no MISO */, TFT_MOSI, TFT_CS);
  tft.init(TFT_W, TFT_H);
  tft.setSPISpeed(SPI_HZ);
  tft.setRotation(0);
  tft.fillScreen(ST77XX_BLACK);

  logf("playing %d frames at %dx%d, SPI %d Hz", GIF_FRAME_COUNT, GIF_FRAME_W, GIF_FRAME_H, SPI_HZ);
}

void loop() {
  static uint8_t frameIdx = 0;
  static int16_t yOffset = (TFT_H - GIF_FRAME_H) / 2;
  static uint32_t frameCount = 0, fpsWindowStart = 0, decodeMsAccum = 0, pushMsAccum = 0;
  if (fpsWindowStart == 0) fpsWindowStart = millis();

  uint32_t t0 = millis();
  decodeFrame(frameIdx);
  uint32_t t1 = millis();

  tft.startWrite();
  tft.setAddrWindow(0, yOffset, GIF_FRAME_W, GIF_FRAME_H);
  tft.writePixels(frameBuf, GIF_FRAME_W * GIF_FRAME_H);
  tft.endWrite();
  uint32_t t2 = millis();

  decodeMsAccum += (t1 - t0);
  pushMsAccum += (t2 - t1);
  frameCount++;

  uint16_t wantDelay = gifFrameDurationMs[frameIdx];
  frameIdx = (frameIdx + 1) % GIF_FRAME_COUNT;

  uint32_t now = millis();
  if (now - fpsWindowStart >= 1000) {
    logf("FPS:%lu avg_decode_ms:%lu avg_push_ms:%lu",
         (unsigned long)(frameCount * 1000 / (now - fpsWindowStart)),
         (unsigned long)(decodeMsAccum / frameCount),
         (unsigned long)(pushMsAccum / frameCount));
    frameCount = 0;
    decodeMsAccum = 0;
    pushMsAccum = 0;
    fpsWindowStart = now;
  }

  uint32_t spent = t2 - t0;
  if (wantDelay > spent) delay(wantDelay - spent);
}
